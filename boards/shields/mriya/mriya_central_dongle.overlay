#include <dt-bindings/zmk/matrix_transform.h>
#include "mriya-layouts.dtsi"
#include "mriya.dtsi"

&physical_layout0 {
    transform = <&default_transform>;
};

/ {
    chosen {
        zmk,kscan = &mock_kscan;
        zmk,physical-layout = &physical_layout0;
    };
};